## kernel/arch/arm/src/stmp3770/Kconfig
```kconfig
#
# For a description of the syntax of this configuration file,
# see the file kconfig-language.txt in the NuttX tools repository.
#

comment "STMP3770 Configuration Options"


menu "STMP3770 Peripheral Support"

config STMP3770_DEBUG_UART
	bool "UART"
	default y
	select UART_SERIALDRIVER
	
config STMP3770_USB_OTG
	bool "USB OTG"
	default y
    select USBHOST_HAVE_ASYNCH if USBHOST	
	
	
endmenu # STMP3770 Peripheral Support




if STMP3770_USB_OTG && USBDEV

menu "USB device controller driver (DCD) options"

config STMP3770_USBDEV_EP0_MAXSIZE
	int "EP0 Max packet size"
	default 64
	---help---
		Endpoint 0 maximum packet size.  Default: 64

config STMP3770_USBDEV_FRAME_INTERRUPT
	bool "USB frame interrupt"
	default n
	---help---
		Handle USB Start-Of-Frame events.  Enable reading SOF from interrupt
		handler vs. simply reading on demand. Probably a bad idea... Unless
		there is some issue with sampling the SOF from hardware asynchronously.

config STMP3770_USBDEV_DMA
	bool "Enable USB device DMA"
	default n
	---help---
		Enable stmp3770-specific DMA support

config STMP3770_USB0DEV_NOVBUS
	bool "No USB0 VBUS sensing"
	default n
	depends on STMP3770_USB_OTG && USBDEV

config STMP3770_USBDEV_REGDEBUG
	bool "Register level debug"
	depends on DEBUG_USB_INFO
	default n
	---help---
		Output detailed register-level USB device debug information.  Requires
		also CONFIG_DEBUG_USB_INFO.

endmenu # USB device driver controller (DCD) options
endif # STMP3770_USB_OTG && USBDEV
```

## kernel/boards/arm/stmp3770/hp39gii/Kconfig
```kconfig
#
# For a description of the syntax of this configuration file,
# see the file kconfig-language.txt in the NuttX tools repository.
#

if ARCH_BOARD_HP39GII

if PAGING

config HP39GII_PAGING_MOUNTPT
	string "Page device mount point"
	default "/mnt/pgsrc"

endif # PAGING
endif # ARCH_BOARD_HP39GII
```
